## ESP32/DTLS13-wifi-station-client/components/wolfssl/Kconfig
```kconfig
#
# Copyright (C) 2006-2022 wolfSSL Inc.  All rights reserved.
#
# This file is part of wolfSSL.
#
# Contact licensing@wolfssl.com with any questions or comments.
#
# https://www.wolfssl.com
#/
#
# Kconfig for wolfssl
#
menu "wolfSSL"

    config TLS_STACK_WOLFSSL
        bool "Include wolfSSL in ESP-TLS"
        default y
        select FREERTOS_ENABLE_BACKWARD_COMPATIBILITY
        help
            Includes wolfSSL in ESP-TLS so that it can be compiled with wolfSSL as its SSL/TLS library.

    config WOLFSSL_HAVE_ALPN
        bool "Enable ALPN (Application Layer Protocol Negotiation) in wolfSSL"
        default n

    config WOLFSSL_ALLOW_TLS12
        bool "Allow TLS 1.2"
        default n
        help
            Allow TLS to fallback to TLS1.2. Memory footprint will likely be larger for TLS1.2.
            When disabled HTTPS and MQTT over TLS connections will fail if TLS1.3 not accepted.

endmenu # wolfSSL
```

## ESP32/DTLS13-wifi-station-server/components/wolfssl/Kconfig.projbuild.bak
```kconfig
#
#  Copyright (C) 2006-2023 wolfSSL Inc.
#
#  This file is part of wolfSSL.
#
#  wolfSSL is free software; you can redistribute it and/or modify
#  it under the terms of the GNU General Public License as published by
#  the Free Software Foundation; either version 2 of the License, or
#  (at your option) any later version.
#
#  wolfSSL is distributed in the hope that it will be useful,
#  but WITHOUT ANY WARRANTY; without even the implied warranty of
#  MERCHANTABILITY or FITNESS FOR A PARTICULAR PURPOSE.  See the
#  GNU General Public License for more details.
#
#  You should have received a copy of the GNU General Public License
#  along with this program; if not, write to the Free Software
#  Foundation, Inc., 51 Franklin Street, Fifth Floor, Boston, MA 02110-1335, USA
#

#
# See https://docs.espressif.com/projects/esp-idf/en/v4.2-beta1/esp32/api-guides/build-system.html#kconfig-projbuild
#
# " This is an equivalent to project_include.cmake for Component Configuration
# KConfig files. If you want to include configuration options at the top-level
# of menuconfig, rather than inside the “Component Configuration” sub-menu,
# then these can be defined in the KConfig.projbuild file alongside the
# CMakeLists.txt file. "

menu "Example wolfSSL Configuration"

    config EXAMPLE_CONNECT_WIFI
        bool "connect wolfssl using WiFi interface"
        depends on !IDF_TARGET_LINUX
        default y
        help
            Protocol examples can use Wi-Fi and/or Ethernet to connect to the network.
            Choose this option to connect with WiFi
```

## ESP32/TLS13-wifi_station-client/main/Kconfig.projbuild
```kconfig
menu "Example Configuration"

    config ESP_WIFI_SSID
        string "WiFi SSID"
        default "myssid"
        help
            SSID (network name) for the example to connect to.

    config ESP_WIFI_PASSWORD
        string "WiFi Password"
        default "mypassword"
        help
            WiFi password (WPA or WPA2) for the example to use.

    config TLS_SMP_TARGET_HOST
        string "Target Host"
        default "127.0.0.1"
        help
            Set the target host IP address / domain

    config ESP_MAXIMUM_RETRY
        int "Maximum retry"
        default 5
        help
            Set the Maximum retry to avoid station reconnecting to the AP unlimited when the AP is really inexistent.
endmenu
```

## meta-wolfssl-linux-fips/layers/meta-network-overrides/conf/layer.conf
```bitbake
# Layer configuration for meta-network-overrides
BBPATH .= ":${LAYERDIR}"

BBFILES += "${LAYERDIR}/recipes-*/*/*.bb \
            ${LAYERDIR}/recipes-*/*/*.bbappend"

BBFILE_COLLECTIONS += "meta-network-overrides"
BBFILE_PATTERN_meta-network-overrides = "^${LAYERDIR}/"
BBFILE_PRIORITY_meta-network-overrides = "6"

LAYERDEPENDS_meta-network-overrides = "core"
LAYERSERIES_COMPAT_meta-network-overrides = "scarthgap"
```

## meta-wolfssl-linux-fips/layers/meta-wolfssl-overrides/conf/layer.conf
```bitbake
# Layer configuration for meta-wolfssl-overrides
#
# This layer provides bbappends and overrides for meta-wolfssl recipes,
# customizing wolfSSL for the RPi5 FIPS build.

# We have a conf and classes directory, add to BBPATH
BBPATH .= ":${LAYERDIR}"

# We have recipes-* directories, add to BBFILES
BBFILES += "${LAYERDIR}/recipes-*/*/*.bb \
            ${LAYERDIR}/recipes-*/*/*.bbappend"

BBFILE_COLLECTIONS += "meta-wolfssl-overrides"
BBFILE_PATTERN_meta-wolfssl-overrides = "^${LAYERDIR}/"
BBFILE_PRIORITY_meta-wolfssl-overrides = "7"

LAYERDEPENDS_meta-wolfssl-overrides = "core wolfssl"
LAYERSERIES_COMPAT_meta-wolfssl-overrides = "scarthgap"
```
